## src/mainboard/asrock/z890_pro_rs_wifi/Kconfig
```kconfig
## SPDX-License-Identifier: GPL-2.0-only

config BOARD_ASROCK_Z890_PRO_RS_WIFI
	bool
	select BOARD_ROMSIZE_KB_32768
	select HAVE_ACPI_RESUME
	select HAVE_ACPI_TABLES
	select INTEL_GMA_HAVE_VBT
	select SOC_INTEL_ARROWLAKE_S
	select SUPERIO_NUVOTON_NCT6687D

if BOARD_ASROCK_Z890_PRO_RS_WIFI

config MAINBOARD_DIR
	default "asrock/z890_pro_rs_wifi"

config MAINBOARD_PART_NUMBER
	default "Z890 Pro RS WiFi"

config MAINBOARD_VENDOR
	default "ASRock"

config CBFS_SIZE
	default 0x1000000

config USE_PM_ACPI_TIMER
	default n

config USE_LEGACY_8254_TIMER
	default y

endif
```

## src/mainboard/asrock/z890_pro_rs_wifi/Kconfig.name
```kconfig
## SPDX-License-Identifier: GPL-2.0-only

config BOARD_ASROCK_Z890_PRO_RS_WIFI
	bool "Z890 Pro RS WiFi"
```

## src/soc/intel/common/block/pcr/Kconfig
```kconfig
## SPDX-License-Identifier: GPL-2.0-only

config SOC_INTEL_COMMON_BLOCK_PCR
	bool
	help
	  Intel Processor common Private configuration registers (PCR)

config SOC_INTEL_COMMON_BLOCK_PCR_VIRTUAL_PIDS
	bool
	depends on SOC_INTEL_COMMON_BLOCK_PCR
	help
	  Let the SoC give a port id that stands for a port on another
	  P2SB, such as the one on a separate chipset die. The SoC provides
	  soc_pcr_resolve_pid(), and accesses to such a port go through the
	  sideband interface registers in that P2SB's PCI configuration space
	  instead of through the memory mapped PCR window.

config PCR_COMMON_IOSF_1_0
	bool
	depends on SOC_INTEL_COMMON_BLOCK_PCR
	help
	  The mapping of addresses via the SBREG_BAR assumes the IOSF-SB
	  agents are using 32-bit aligned accesses for their configuration
	  registers. For IOSF versions greater than 1_0, IOSF-SB
	  agents can use any access (8/16/32 bit aligned) for their
	  configuration registers
```
